## arch/arm/mach-apple/Kconfig
```kconfig
#
# Apple architecture dependent features.
#
# This program is free software; you can redistribute it and/or
# modify it under the terms of the GNU General Public License as
# published by the Free Software Foundation; either version 2 of
# the License, or (at your option) any later version.
#
# This program is distributed in the hope that it will be useful,
# but WITHOUT ANY WARRANTY; without even the implied warranty of
# MERCHANTABILITY or FITNESS FOR A PARTICULAR PURPOSE. See the
# GNU General Public License for more details.
#

menu "Apple Features"
        depends on ARCH_APPLE

config ARCH_APPLE_M1
	bool
	help
	  Say Y here to support the Apple M1 SoC.

endmenu
```

## drivers/clk/Kconfig
```kconfig
# SPDX-License-Identifier: GPL-2.0-only
config HAVE_CLK
        default y
	bool

config CLKDEV_LOOKUP
        default y
	bool

config COMMON_CLK
	select HAVE_CLK
	default y
	bool

config COMMON_CLK_OF_PROVIDER
	bool
	default y
	depends on OFTREE
	help
	  Clock driver provides OF-Tree based clock lookup.

config CLK_SOCFPGA
	bool
	select COMMON_CLK_OF_PROVIDER
	default y if ARCH_SOCFPGA && OFDEVICE

source "drivers/clk/sifive/Kconfig"
```

## drivers/nvme/host/Kconfig
```kconfig
# SPDX-License-Identifier: GPL-2.0-only
config NVME_CORE
	bool

config BLK_DEV_NVME
	bool "NVM Express block device"
	depends on BLOCK
	select NVME_CORE
	help
	  The NVM Express driver is for solid state drives directly
	  connected to the PCI or PCI Express bus.  If you know you
	  don't have one of these, it is safe to answer N.

config BLK_DEV_NVME_APPLE
        bool "NVMe driver for Apple M1 SOCs"
	depends on BLK_DEV_NVME
	help
	  Apple M1 SOC NVMe driver.
```

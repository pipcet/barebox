// SPDX-License-Identifier: GPL-2.0+ OR MIT
/*
 * Apple Mac mini (M1, 2020)
 *
 * target-type: J274
 *
 * Copyright The Asahi Linux Contributors
 */

/dts-v1/;

#include "apple-m1.dtsi"

/ {
	compatible = "apple,j274", "apple,t8103", "apple,arm-platform";
	model = "Apple Mac mini (M1, 2020)";

	chosen {
		#address-cells = <2>;
		#size-cells = <2>;
		ranges;

		stdout-path = "serial0";


	};

#if 0
	memory@800000000 {
		device_type = "memory";
		reg = <0x8 0 0x0 0x40000000>; /* To be filled by loader */
	};
#endif
};
